## arch/arm/hotplug/Kconfig
```kconfig
config MSM_HOTPLUG
	bool "MSM hotplug driver"
	depends on HOTPLUG_CPU
	default y
	help
	  The MSM hotplug driver controls on-/offlining of additional cores based
	  on current cpu load.

config INTELLI_HOTPLUG
	bool "Intelli hotplug driver"
	depends on HOTPLUG_CPU
	default y
	help
	  An intelligent cpu hotplug driver for
	  Low Latency Frequency Transition capable processors.

config BRICKED_HOTPLUG
	bool "Enable kernel based mpdecision"
	depends on MSM_RUN_QUEUE_STATS
	default y
	help
	  This enables kernel based multi core control.
	  (up/down hotplug based on load)

config INTELLI_PLUG
        bool "Enable intelli-plug cpu hotplug driver"
        default n
        help
          Generic Intelli-plug cpu hotplug driver for ARM SOCs
	  
config ALUCARD_HOTPLUG
	bool "Enable alucard-hotplug cpu hotplug driver"
	default y
	help
	  Generic Alucard-hotplug cpu hotplug driver for ARM SOCs

config ZEN_DECISION
	bool "Zen Decision: MSM Userspace Handler"
	depends on SMP && FB
	default y
	help
	  MSM/Qcomm devices have multiple userspace applications that handle
	  CPU hotplugging and frequency operations.

	  ZenDecision is a partial resolution to handling behavior caused by
	  disabling some of these services.

	  For example, If MPDecision is disabled and MSM-Thermal_Engine is 
	  enabled in the userspace. Situations where CPUs go offline but never
	  come back online occur.
  
	  ZenDecision ensures all CPUs are online when they are supposed to be by:
	  - Enable all CPUs when screen comes on after zen_wake_delay
	  - Ignore all CPU_UP operations when battery level is <= 15% to respect
	    the decision made by MSMThermal (which disables cores at <= 15% battery)

	  Thresholds and driver enable/disable for above values can be found in:
	  /sys/kernel/zen_decision

	  ZenDecision is not a direct replacement for any of the MSM userspace
	  services.

	  If unsure, say N.
	  
config MAKO_HOTPLUG
        bool "Enable mako-hotplug cpu hotplug driver"
        default n
        help
          Generic Intelli-plug cpu hotplug driver for ARM SOCs	  

config BLU_PLUG
	bool "Dynamic hotplug driver"
	depends on HOTPLUG_CPU
	default n
	help
	  The Dynamic hotplug driver automatically online/offline CPUs proportional to system load.
	  
	  
config FAST_HOTPLUG
	bool "Enable fast hotplug"
	default n
	help
	  Kernel based core control.
	  
config THUNDERPLUG_CONTROL
      bool "Enable plugging down/up of cores using powersuspend"
      default n
      help
       This driver uses powersuspend to take down the cpu cores
       on a octa core device. Tuned to work on a quad core device.

config MSM_SLEEPER
	bool "Limit max frequency while screen is off"
	default n
	help
	  Limit max frequency while screen is off 

config ASMP
 	bool "Multi-core automatic hotplug support"
 	depends on SMP
 	default y
 	help
 	Automatically hotplugs the multiple cpu cores on and off
 	based on cpu load and suspend stat
```

## arch/arm/mach-msm/lge/8974ac-g3/Kconfig
```kconfig
config MACH_MSM8974_G3
	bool
	select LEDS_PM8941_EMOTIONAL
	select LGE_PM_BATTERY_ID_CHECKER
	select LGE_PM_LLK_MODE
	select LGE_PM_USB_CURRENT_MAX_MODE
	select LGE_SHARPENING
	select LGE_THERMALE_CHG_CONTROL
	select MACH_LGE
	select SND_SOC_CS35L32
	select SND_SOC_TPA2015D

config MACH_MSM8974_G3_KR
	depends on ARCH_MSM8974
	select MACH_MSM8974_G3
	select LGE_MMC_SD_USE_SDCC3
	bool "MSM8974 G3 KR"
	help
	  Support for the Qualcomm MSM8974 G3 KR device.

config MACH_MSM8974_G3_VZW
	depends on ARCH_MSM8974
	select MACH_MSM8974_G3
	bool "MSM8974 G3 VZW"
	help
	  Support for the Qualcomm MSM8974 G3 Verizon device.

config MACH_MSM8974_G3_ATT
	depends on ARCH_MSM8974
	select MACH_MSM8974_G3
	bool "MSM8974 G3 ATT"
	help
	  Support for the Qualcomm MSM8974 G3 AT&T device.

config MACH_MSM8974_G3_SPR_US
	depends on ARCH_MSM8974
	select MACH_MSM8974_G3
	select LGE_MMC_SD_USE_SDCC3
	bool "MSM8974 G3 SPR US"
	help
	  Support for the Qualcomm MSM8974 G3 Sprint device.

config MACH_MSM8974_G3_TMO_US
	depends on ARCH_MSM8974
	select MACH_MSM8974_G3
	select LGE_MMC_SD_USE_SDCC3
	bool "MSM8974 G3 TMO US"
	help
	  Support for the Qualcomm MSM8974 G3 AT&T device.

config MACH_MSM8974_G3_GLOBAL_COM
	depends on ARCH_MSM8974
	select MACH_MSM8974_G3
	bool "MSM8974 G3 GLOBAL COM"
	help
	  Support for the Qualcomm MSM8974 G3 GLOBAL device.

config MACH_MSM8974_G3_CA
	depends on ARCH_MSM8974
	select MACH_MSM8974_G3
	bool "MSM8974 G3 CA"
	help
	  Support for the Qualcomm MSM8974 G3 Canada device.

config MACH_MSM8974_G3_CN
	depends on ARCH_MSM8974
	select MACH_LGE
	select MACH_MSM8974_G3
	bool "MSM8974 G3 CN"
	help
	  Support for the Qualcomm MSM8974 G3 CHINA device.

config MACH_MSM8974_G3_CMCC_CN
	depends on ARCH_MSM8974
	select MACH_LGE
	select MACH_MSM8974_G3
	bool "MSM8974 G3 CMCC CN"
	help
	  Support for the Qualcomm MSM8974 G3 CMCC device.

config MACH_MSM8974_G3_CTC_CN
	depends on ARCH_MSM8974
	select MACH_LGE
	select MACH_MSM8974_G3
	bool "MSM8974 G3 CTC CN"
	help
	  Support for the Qualcomm MSM8974 G3 CTC device.

config MACH_MSM8974_G3_CUCC_CN
	depends on ARCH_MSM8974
	select MACH_LGE
	select MACH_MSM8974_G3
	bool "MSM8974 G3 CUCC CN"
	help
	  Support for the Qualcomm MSM8974 G3 CUCC device.

config MACH_MSM8974_G3_OPEN_HK
	depends on ARCH_MSM8974
	select MACH_LGE
	select MACH_MSM8974_G3
	bool "MSM8974 G3 OPEN HK"
	help
	  Support for the Qualcomm MSM8974 G3 OPEN_HK device.
```

## arch/arm/mach-msm/lge/Kconfig
```kconfig
config MACH_LGE
	bool

menu "LGE Board Selection"

source "arch/arm/mach-msm/lge/8974ac-g3/Kconfig"

config DTS_TARGET
	string "DTS target dir"
	help
	  CONFIG_DTS_TARGET should be set to support appended dts.
	  ex) CONFIG_DTS_TARGET="msm8974-g3".

config LGE_BOOTLOADER_LOG
	tristate "Support LGE bootloader log"
	default n
	depends on MACH_LGE
	help
	  LGE bootloader log

config LGE_PSEUDO_CHG_UI
	bool "Support pseudo charging UI"
	default n
	depends on MACH_LGE
	help
	  LGE PSEUDO CHG UI.

config LGE_BOOTLOADER_TIME_CHECKER
	bool "Show bootloader(LK, SBL) time"
	default n
	depends on MACH_LGE
	help
	  This shows the lk and sbl1 booting time in MSM8974.
	  If this feature is enabled, it should be check by adb shell.
	  Device Node : sys/module/lge_bootloader_time_checker/

config LGE_USES_SMD_DS_TTY
	bool "Explicitly use smd tty driver for DS"
	default n
	depends on MSM_SMD_TTY && MACH_LGE
	help
	  In Qualcomm MSM89xx, smd tty driver for ds(/dev/smd0) is not used.
	  Say yes if this tty driver must be used on LGE device. This is used
	  to connect smd channel in user space(for example, ATCMD processing).

config LGE_KSWITCH
	tristate "Support LGE Kill Switch"
	default n
	depends on MACH_LGE
	help
	  LGE Kill Switch

config LGE_QFPROM_INTERFACE
	bool "Support qfprom interface"
	default n
	depends on MACH_LGE
	help
	  LGE QFPROM DRIVER.

config SHITTY_VARIANT
	bool "Whether or not this is a shitty variant"
	default n
	help
	  Some variants are shitty. In this particular case, shitty means that no matter
	  what you do, they simply won't boot when the kernel is built with gcc 4.9.
	  This flag will allow these variants to opt out of the code tha causes the
	  section mismatches and allow them to continue on with their presumably shitty
	  existance and gcc 4.8.

endmenu
```
