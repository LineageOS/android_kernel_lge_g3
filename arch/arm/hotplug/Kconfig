## drivers/cpufreq/Kconfig
```kconfig
menu "CPU Frequency scaling"

config CPU_FREQ
	bool "CPU Frequency scaling"
	help
	  CPU Frequency scaling allows you to change the clock speed of 
	  CPUs on the fly. This is a nice method to save power, because 
	  the lower the CPU clock speed, the less power the CPU consumes.

	  Note that this driver doesn't automatically change the CPU
	  clock speed, you need to either enable a dynamic cpufreq governor
	  (see below) after boot, or use a userspace tool.

	  For details, take a look at <file:Documentation/cpu-freq>.

	  If in doubt, say N.

if CPU_FREQ

config CPU_FREQ_TABLE
	tristate

config CPU_FREQ_STAT
	tristate "CPU frequency translation statistics"
	select CPU_FREQ_TABLE
	default y
	help
	  This driver exports CPU frequency statistics information through sysfs
	  file system.

	  To compile this driver as a module, choose M here: the
	  module will be called cpufreq_stats.

	  If in doubt, say N.

config CPU_FREQ_STAT_DETAILS
	bool "CPU frequency translation statistics details"
	depends on CPU_FREQ_STAT
	help
	  This will show detail CPU frequency translation table in sysfs file
	  system.

	  If in doubt, say N.

choice
	prompt "Default CPUFreq governor"
	default CPU_FREQ_DEFAULT_GOV_USERSPACE if CPU_FREQ_SA1100 || CPU_FREQ_SA1110
	default CPU_FREQ_DEFAULT_GOV_PERFORMANCE
	help
	  This option sets which CPUFreq governor shall be loaded at
	  startup. If in doubt, select 'performance'.

config CPU_FREQ_DEFAULT_GOV_PERFORMANCE
	bool "performance"
	select CPU_FREQ_GOV_PERFORMANCE
	help
	  Use the CPUFreq governor 'performance' as default. This sets
	  the frequency statically to the highest frequency supported by
	  the CPU.

config CPU_FREQ_DEFAULT_GOV_POWERSAVE
	bool "powersave"
	depends on EXPERT
	select CPU_FREQ_GOV_POWERSAVE
	help
	  Use the CPUFreq governor 'powersave' as default. This sets
	  the frequency statically to the lowest frequency supported by
	  the CPU.

config CPU_FREQ_DEFAULT_GOV_USERSPACE
	bool "userspace"
	select CPU_FREQ_GOV_USERSPACE
	help
	  Use the CPUFreq governor 'userspace' as default. This allows
	  you to set the CPU frequency manually or when a userspace 
	  program shall be able to set the CPU dynamically without having
	  to enable the userspace governor manually.

config CPU_FREQ_DEFAULT_GOV_ONDEMAND
	bool "ondemand"
	select CPU_FREQ_GOV_ONDEMAND
	select CPU_FREQ_GOV_PERFORMANCE
	help
	  Use the CPUFreq governor 'ondemand' as default. This allows
	  you to get a full dynamic frequency capable system by simply
	  loading your cpufreq low-level hardware driver.
	  Be aware that not all cpufreq drivers support the ondemand
	  governor. If unsure have a look at the help section of the
	  driver. Fallback governor will be the performance governor.

config CPU_FREQ_DEFAULT_GOV_CONSERVATIVE
	bool "conservative"
	select CPU_FREQ_GOV_CONSERVATIVE
	select CPU_FREQ_GOV_PERFORMANCE
	help
	  Use the CPUFreq governor 'conservative' as default. This allows
	  you to get a full dynamic frequency capable system by simply
	  loading your cpufreq low-level hardware driver.
	  Be aware that not all cpufreq drivers support the conservative
	  governor. If unsure have a look at the help section of the
	  driver. Fallback governor will be the performance governor.

config CPU_FREQ_DEFAULT_GOV_ZZMOOVE
	  bool "zzmoove"
	  select CPU_FREQ_GOV_ZZMOOVE
	  select CPU_FREQ_GOV_PERFORMANCE
	  help
	  Use the CPUFreq governor 'zzmoove' as default, using predefined
	  frequency lookup tables and optimized scaling triggers instead of
	  % frequency steps to get smooth up/downscaling dependant on CPU load.

config CPU_FREQ_DEFAULT_GOV_INTERACTIVE
	bool "interactive"
	select CPU_FREQ_GOV_INTERACTIVE
	help
	  Use the CPUFreq governor 'interactive' as default. This allows
	  you to get a full dynamic cpu frequency capable system by simply
	  loading your cpufreq low-level hardware driver, using the
	  'interactive' governor for latency-sensitive workloads.

config CPU_FREQ_DEFAULT_GOV_PEGASUSQ
	bool "pegasusq"
	select CPU_FREQ_GOV_PEGASUSQ
	help
	Use the CPUFreq governor 'pegasusq' as default.

config CPU_FREQ_DEFAULT_GOV_ALUCARD
  	bool "alucard"
  	select CPU_FREQ_GOV_ALUCARD
  	help
  	
config CPU_FREQ_DEFAULT_GOV_BIOSHOCK
	bool "bioshock"
	select CPU_FREQ_GOV_BIOSHOCK
	help
	Use the CPUFreq governor 'bioshock' as default.

config CPU_FREQ_DEFAULT_GOV_DARKNESS
	bool "darkness"
	select CPU_FREQ_GOV_DARKNESS
	help

config CPU_FREQ_DEFAULT_GOV_IMPULSE
	bool "impulse"
	select CPU_FREQ_GOV_IMPULSE
	help
	  Use the CPUFreq governor 'interactive' as default.	

config CPU_FREQ_DEFAULT_GOV_INTELLIACTIVE
	bool "intelliactive"
	select CPU_FREQ_GOV_INTELLIACTIVE
	help
	  Use the CPUFreq governor 'intelliactive' as default. This allows
	  you to get a full dynamic cpu frequency capable system by simply
	  loading your cpufreq low-level hardware driver, using the
	  'interactive' governor for latency-sensitive workloads.	
	
config CPU_FREQ_DEFAULT_GOV_INTELLIMM
	bool "intelliminmax"
	select CPU_FREQ_GOV_INTELLIMM
	help
	  Use the CPUFreq governor 'intelliminmax' as default. This is
	  governor will use only 3 different frequencies, idle, UI and max
	  
config CPU_FREQ_DEFAULT_GOV_LIONHEART
	bool "lionheart"
	select CPU_FREQ_GOV_LIONHEART
	help
	  Use the CPUFreq governor 'lionheart' as default.

config CPU_FREQ_DEFAULT_GOV_NIGHTMARE
	bool "nightmare"
	select CPU_FREQ_GOV_NIGHTMARE
	help

config CPU_FREQ_DEFAULT_GOV_RAGINGMOLASSES
   	bool "ragingmolasses"
   	select CPU_FREQ_GOV_RAGINGMOLASSES
   	help
   	  Select ragingmolasses cpu governor as default
   	  
config CPU_FREQ_DEFAULT_GOV_SMARTASSV2
	bool "smartass2"
	select CPU_FREQ_GOV_SMARTASSV2
	help
	Use the CPUFreq governor 'smartassV2' as default.   	  	
   	  
config CPU_FREQ_DEFAULT_GOV_SMARTMAX
        bool "smartmax"
        select CPU_FREQ_GOV_SMARTMAX
        help
          Use the CPUFreq governor 'smartmax' as default
          
config CPU_FREQ_DEFAULT_GOV_SLIM
	bool "slim"
	select CPU_FREQ_GOV_SLIM
	help             
          
config CPU_FREQ_DEFAULT_GOV_TRIPNDROID
	bool "tripndroid"
	select CPU_FREQ_GOV_TRIPNDROID
	help
	  Select tripndroid cpu governor as default              	    

config CPU_FREQ_DEFAULT_GOV_WAVE
	bool "wave"
	select CPU_FREQ_GOV_WAVE
	help   
	
config CPU_FREQ_DEFAULT_GOV_WHEATLEY
	bool "wheatley"
	select CPU_FREQ_GOV_WHEATLEY
	select CPU_FREQ_GOV_PERFORMANCE
	---help---
	  Use the CPUFreq governor 'wheatley' as default.

config CPU_FREQ_DEFAULT_GOV_YANKACTIVE
	bool "yankactive"
	select CPU_FREQ_GOV_YANKACTIVE
	help
	  Use the CPUFreq governor 'yankactive' as default. This allows
	  you to get a full dynamic cpu frequency capable system by simply
	  loading your cpufreq low-level hardware driver, using the
	  'yankactive' governor for latency-sensitive workloads.

config CPU_FREQ_DEFAULT_GOV_BADASS
	bool "badass"
	select CPU_FREQ_GOV_BADASS
	select CPU_FREQ_GOV_PERFORMANCE
	help
	  Use the CPUFreq governor 'badass' as default. This allows
	  you to get a full dynamic frequency capable system by simply
	  loading your cpufreq low-level hardware driver.
	  Be aware that not all cpufreq drivers support the badass
	  governor. If unsure have a look at the help section of the
	  driver. Fallback governor will be the performance governor.

config CPU_FREQ_DEFAULT_GOV_SMARTASSH3
	bool "smartassH3"
	select CPU_FREQ_GOV_SMARTASSH3
	help
	  Use the CPUFreq governor 'SmartassH3' as default.

config CPU_FREQ_DEFAULT_GOV_YANKDEMAND
	bool "yankdemand"
	select CPU_FREQ_GOV_YANKDEMAND
	select CPU_FREQ_GOV_PERFORMANCE
	help
	  Use the CPUFreq governor 'yankdemand' as default. This allows
	  you to get a full dynamic frequency capable system by simply
	  loading your cpufreq low-level hardware driver.
	  Be aware that not all cpufreq drivers support the yankdemand
	  governor. If unsure have a look at the help section of the
	  driver. Fallback governor will be the performance governor.

config CPU_FREQ_DEFAULT_GOV_ELEMENTALX
	bool "elementalx"
	select CPU_FREQ_GOV_ELEMENTALX
	select CPU_FREQ_GOV_PERFORMANCE
	help
	  Use the CPUFreq governor 'elementalx' as default.

config CPU_FREQ_DEFAULT_GOV_DANCEDANCE
	bool "DanceDance"
	select CPU_FREQ_GOV_DANCEDANCE

config CPU_FREQ_DEFAULT_GOV_SAVAGEDZEN
	bool "SavagedZen"
	select CPU_FREQ_GOV_SAVAGEDZEN
	select CPU_FREQ_GOV_PERFORMANCE
	help
	  Use the CPUFreq governor 'savagedzen' as default.

config CPU_FREQ_DEFAULT_GOV_HYPER
	bool "hyper"
	select CPU_FREQ_GOV_HYPER
	  help
	  Use the CPUFreq governor 'hyper' as default.

config CPU_FREQ_DEFAULT_GOV_ADAPTIVE
	bool "adaptive"
	select CPU_FREQ_GOV_ADAPTIVE
	---help---
	  Use the CPUFreq governor 'adaptive' as default. This allows
	  you to get a full dynamic cpu frequency capable system by simply
	  loading your cpufreq low-level hardware driver, using the
	  'adaptive' governor for latency-sensitive workloads and demanding
	  performance.

config CPU_FREQ_DEFAULT_GOV_LAGFREE
        bool "lagfree"
        select CPU_FREQ_GOV_LAGFREE
        help
          Use the CPUFreq governor 'lagfree' as default. This allows
          you to get a full dynamic frequency capable system by simply
          loading your cpufreq low-level hardware driver.
          Be aware that not all cpufreq drivers support the lagfree
          governor. If unsure have a look at the help section of the
          driver. Fallback governor will be the performance governor.
		  
config CPU_FREQ_DEFAULT_GOV_BLU_ACTIVE
	bool "blu_active"
	select CPU_FREQ_GOV_BLU_ACTIVE
	help
	  Use the CPUFreq governor 'blu_active' as default. This allows
  	  you to get a full dynamic cpu frequency capable system by simply
  	  loading your cpufreq low-level hardware driver, using the
	  'interactive' governor for latency-sensitive workloads.
	 
config CPU_FREQ_DEFAULT_GOV_OPTIMAX
	bool "optimax"
	select CPU_FREQ_GOV_OPTIMAX
  	help
	Use the CPUFreq governor 'optimax' as default

config CPU_FREQ_DEFAULT_GOV_BARRY_ALLEN
	bool "barry_allen"
	select CPU_FREQ_GOV_BARRY_ALLEN
	help
	  Use the CPUFreq governor 'barry_allen' as default. This allows
	  you to get a full dynamic cpu frequency capable system by simply
	  loading your cpufreq low-level hardware driver, using the
	  'barry_allen' governor for latency-sensitive workloads.
	  
config CPU_FREQ_DEFAULT_GOV_MYTHX_PLUG
	bool "mythx_plug"
	select CPU_FREQ_GOV_MYTHX_PLUG
	help
	  Wat
	  
config CPU_FREQ_DEFAULT_GOV_BOOSTACTIVE
	bool "boostactive"
	select CPU_FREQ_GOV_BOOSTACTIVE
	help
	  Use the CPUFreq governor 'boostactive' as default. This allows
	  you to get a full dynamic cpu frequency capable system by simply
	  loading your cpufreq low-level hardware driver, using the
	  'interactive' governor for latency-sensitive workloads.
	  
config CPU_FREQ_DEFAULT_GOV_KTOONSERVATIVEQ
	bool "ktoonservativeq"
	select CPU_FREQ_GOV_KTOONSERVATIVEQ
	help
	  Use the CPUFreq governor 'ktoonservativeq' as default. This allows
	  you to get a full dynamic frequency capable system by simply
	  loading your cpufreq low-level hardware driver.
	  Be aware that not all cpufreq drivers support the ktoonservativeq
	  governor. If unsure have a look at the help section of the
	  driver. Fallback governor will be the performance governor.  This
	  governor adds the capability of hotpluging.
	  
config CPU_FREQ_DEFAULT_GOV_ABYSSPLUG
	bool "abyssplug"
	select CPU_FREQ_GOV_ABYSSPLUG
	help
	  Use the CPUFreq governor 'abyssplug' as default. This allows you
	  to get a full dynamic frequency capable system with CPU
	  hotplug support by simply loading your cpufreq low-level
	  hardware driver.  Be aware that not all cpufreq drivers
	  support the hotplug governor. If unsure have a look at
	  the help section of the driver. Fallback governor will be the
	  performance governor.
	  
config CPU_FREQ_DEFAULT_GOV_SLP
	bool "slp"
	select CPU_FREQ_GOV_SLP
	help
	  Use the CPUFreq governor 'slp' as default.

config CPU_FREQ_DEFAULT_GOV_INTERACTIVEX
		bool "interactivex"
		select CPU_FREQ_GOV_INTERACTIVEX
		help

endchoice

config CPU_FREQ_GOV_PERFORMANCE
	tristate "'performance' governor"
	help
	  This cpufreq governor sets the frequency statically to the
	  highest available CPU frequency.

	  To compile this driver as a module, choose M here: the
	  module will be called cpufreq_performance.

	  If in doubt, say Y.

config CPU_FREQ_GOV_POWERSAVE
	tristate "'powersave' governor"
	help
	  This cpufreq governor sets the frequency statically to the
	  lowest available CPU frequency.

	  To compile this driver as a module, choose M here: the
	  module will be called cpufreq_powersave.

	  If in doubt, say Y.

config CPU_FREQ_GOV_USERSPACE
	tristate "'userspace' governor for userspace frequency scaling"
	help
	  Enable this cpufreq governor when you either want to set the
	  CPU frequency manually or when a userspace program shall
	  be able to set the CPU dynamically, like on LART 
	  <http://www.lartmaker.nl/>.

	  To compile this driver as a module, choose M here: the
	  module will be called cpufreq_userspace.

	  For details, take a look at <file:Documentation/cpu-freq/>.

	  If in doubt, say Y.

config CPU_FREQ_GOV_ONDEMAND
	tristate "'ondemand' cpufreq policy governor"
	select CPU_FREQ_TABLE
	help
	  'ondemand' - This driver adds a dynamic cpufreq policy governor.
	  The governor does a periodic polling and 
	  changes frequency based on the CPU utilization.
	  The support for this governor depends on CPU capability to
	  do fast frequency switching (i.e, very low latency frequency
	  transitions). 

	  To compile this driver as a module, choose M here: the
	  module will be called cpufreq_ondemand.

	  For details, take a look at linux/Documentation/cpu-freq.

	  If in doubt, say N.

config CPU_FREQ_GOV_INTERACTIVE
	tristate "'interactive' cpufreq policy governor"
	help
	  'interactive' - This driver adds a dynamic cpufreq policy governor
	  designed for latency-sensitive workloads.

	  This governor attempts to reduce the latency of clock
	  increases so that the system is more responsive to
	  interactive workloads.

	  To compile this driver as a module, choose M here: the
	  module will be called cpufreq_interactive.

	  For details, take a look at linux/Documentation/cpu-freq.

	  If in doubt, say N.

config CPU_FREQ_GOV_CONSERVATIVE
	tristate "'conservative' cpufreq governor"
	depends on CPU_FREQ
	help
	  'conservative' - this driver is rather similar to the 'ondemand'
	  governor both in its source code and its purpose, the difference is
	  its optimisation for better suitability in a battery powered
	  environment.  The frequency is gracefully increased and decreased
	  rather than jumping to 100% when speed is required.

	  If you have a desktop machine then you should really be considering
	  the 'ondemand' governor instead, however if you are using a laptop,
	  PDA or even an AMD64 based computer (due to the unacceptable
	  step-by-step latency issues between the minimum and maximum frequency
	  transitions in the CPU) you will probably want to use this governor.

	  To compile this driver as a module, choose M here: the
	  module will be called cpufreq_conservative.

	  For details, take a look at linux/Documentation/cpu-freq.

	  If in doubt, say N.

config CPU_FREQ_GOV_ZZMOOVE
	tristate "'zzmoove' cpufreq governor"
	depends on CPU_FREQ
	help
	  'zzmoove' - based on cpufreq_conservative, using predefined
	  frequency lookup tables and optimized scaling triggers instead of
	  % frequency steps to get smooth up/downscaling dependant on CPU load.
	  If in doubt, say N.

config CPU_FREQ_GOV_PEGASUSQ
	tristate "'pegasusq' cpufreq policy governor"

config CPU_FREQ_GOV_ALUCARD
	tristate "'alucard' cpufreq governor"
	depends on CPU_FREQ

config CPU_FREQ_GOV_BIOSHOCK
	tristate "'bioshock' cpufreq bioshock"
	depends on CPU_FREQ
	help
	  'bioshock' - More aggressive version of conservative
	  
config CPU_FREQ_GOV_DARKNESS
	tristate "'darkness' cpufreq governor"
	depends on CPU_FREQ

config CPU_FREQ_GOV_IMPULSE
	tristate "'impulse' cpufreq policy governor"
	help
	  'impulse' - This driver adds a dynamic cpufreq policy governor
	  designed for optimized balance between power and performance.

	  If in doubt, say N.
	  
config CPU_FREQ_GOV_INTELLIACTIVE
	tristate "'intelliactive' cpufreq policy governor"
	help
	  'intelliactive' - This driver adds a dynamic cpufreq policy governor
	  designed for latency-sensitive workloads.

	  This governor attempts to reduce the latency of clock
	  increases so that the system is more responsive to
	  interactive workloads.

	  To compile this driver as a module, choose M here: the
	  module will be called cpufreq_interactive.

	  For details, take a look at linux/Documentation/cpu-freq.

	  If in doubt, say N.
	  
config CPU_FREQ_GOV_INTELLIMM
        tristate "'intelliminmax' cpufreq policy governor"
        help
          To compile this driver as a module, choose M here: the
          module will be called cpufreq_interactive.

          For details, take a look at linux/Documentation/cpu-freq.

          If in doubt, say N.
          
config CPU_FREQ_GOV_LIONHEART
	tristate "'lionheart' cpufreq governor"
	depends on CPU_FREQ
	help
	  'lionheart' - A brave and agile conservative-based governor.
	  If in doubt, say N.
	  
config CPU_FREQ_GOV_NIGHTMARE
	tristate "'nightmare' cpufreq governor"
	depends on CPU_FREQ	

config CPU_FREQ_GOV_RAGINGMOLASSES
	tristate "'RAGINGMOLASSES' cpufreq policy governor"
	help
	  'RAGINGMOLASSES' - This driver adds a cpufreq policy governor 
	  much along the lines of ondemand but tries to keep to low 
	  frequencies without hurting performance for workloads that need it.
	  To compile this driver as a module, choose M here: the
	  module will be called cpufreq_interactive.

	  For details, take a look at linux/Documentation/cpu-freq.

	  If in doubt, say N0.
	  
config CPU_FREQ_GOV_SMARTASSV2
	tristate "'smartassV2' cpufreq governor"
	depends on CPU_FREQ
	default n
	help
		'smartassV2' - a "smart" governor
		If in doubt, say N.

config SMARTASSV2_SLEEP_IDEAL_FREQ
	int "The ideal frequency to use when awake."
	default 1190400
	depends on CPU_FREQ_GOV_SMARTASSV2
	help
	  The "ideal" frequency to use when awake. The governor will ramp up faster
	  towards the ideal frequency and slower after it has passed it. Similarly,
	  lowering the frequency towards the ideal frequency is faster than below it.

config SMARTASSV2_AWAKE_IDEAL_FREQ
	int "The ideal frequency to use when suspended."
	default 300000
	depends on CPU_FREQ_GOV_SMARTASSV2
	help
	  The "ideal" frequency to use when suspended.
	  When set to 0, the governor will not track the suspended state (meaning
	  that practically when sleep_ideal_freq==0 the awake_ideal_freq is used
	  also when suspended).

config SMARTASSV2_RAMP_UP_STEP
	int "Freqeuncy delta when ramping up above the ideal freqeuncy."
	default 256000
	depends on CPU_FREQ_GOV_SMARTASSV2
	help
	  Freqeuncy delta when ramping up above the ideal freqeuncy.
	  Zero disables and causes to always jump straight to max frequency.
	  When below the ideal freqeuncy we always ramp up to the ideal freq.

config SMARTASSV2_RAMP_DOWN_STEP
	int "Freqeuncy delta when ramping down below the ideal freqeuncy."
	default 256000
	depends on CPU_FREQ_GOV_SMARTASSV2
	help
	  Freqeuncy delta when ramping down below the ideal freqeuncy.
	  Zero disables and will calculate ramp down according to load heuristic.
	  When above the ideal freqeuncy we always ramp down to the ideal freq.

config SMARTASSV2_MAX_CPU_LOAD
	int "CPU freq will be increased if measured load > max_cpu_load."
	default 50
	depends on CPU_FREQ_GOV_SMARTASSV2
	help
	  CPU freq will be increased if measured load > max_cpu_load.

config SMARTASSV2_MIN_CPU_LOAD
	int "CPU freq will be decreased if measured load < max_cpu_load."
	default 25
	depends on CPU_FREQ_GOV_SMARTASSV2
	help
	  CPU freq will be decreased if measured load < max_cpu_load.

config SMARTASSV2_UP_RATE_US
	int "The minimum amount of time to spend at a frequency before we can ramp up."
	default 48000
	depends on CPU_FREQ_GOV_SMARTASSV2
	help
	  The minimum amount of time to spend at a frequency before we can ramp up.
	  Notice we ignore this when we are below the ideal frequency.

config SMARTASSV2_DOWN_RATE_US
	int "The minimum amount of time to spend at a frequency before we can ramp down."
	default 99000
	depends on CPU_FREQ_GOV_SMARTASSV2
	help
	  The minimum amount of time to spend at a frequency before we can ramp down.
	  Notice we ignore this when we are below the ideal frequency.

config SMARTASSV2_SLEEP_WAKEUP_FREQ
	int "The frequency to set when waking up from sleep."
	default 99999999
	depends on CPU_FREQ_GOV_SMARTASSV2
	help
	  The frequency to set when waking up from sleep.
	  When sleep_ideal_freq=0 this will have no effect.

config SMARTASSV2_SAMPLE_RATE_JIFFIES
	int "Sampling rate."
	default 2
	depends on CPU_FREQ_GOV_SMARTASSV2
	help
	  Sampling rate, I highly recommend to leave it at 2.	  
	  
config CPU_FREQ_GOV_SMARTMAX
        tristate "'smartmax' cpufreq policy governor"
        select CPU_FREQ_TABLE
        help
          'smartmax' combined ondemand and smartass2
          
config CPU_FREQ_GOV_SLIM
	tristate "'slim' cpufreq policy governor"
	select CPU_FREQ_TABLE
	help
	  'slim' - This driver adds a dynamic cpufreq policy governor.

	  To compile this driver as a module, choose M here: the
	  module will be called cpufreq_slim.

	  For details, take a look at linux/Documentation/cpu-freq.

	  If in doubt, say N.
	  
config CPU_FREQ_GOV_TRIPNDROID
    tristate "'tripndroid' cpufreq governor"
    depends on CPU_FREQ
    help
	  Custom cpu governor designed specificly for multi cpu mobile devices.
	  Aiming at a balance between performance and battery lifetime, but it
	  hangs a little bit more towards performance at low latencys.   	  	  

config CPU_FREQ_GOV_WAVE
	tristate "'wave' cpufreq governor"
	depends on CPU_FREQ
	help
	
config CPU_FREQ_GOV_WHEATLEY
	tristate "'wheatley' cpufreq governor"
	depends on CPU_FREQ
	default n

config CPU_FREQ_GOV_YANKACTIVE
	tristate "'yankactive' cpufreq policy governor"
	help
	  'yankactive' - This driver adds a dynamic cpufreq policy governor
	  designed for latency-sensitive workloads.
	  The governor is based on interactive with just different default settings
	  and can be achieved using interactive with a script. This is added for
	  simplification purposes for myself.

config CPU_FREQ_GOV_BADASS
	tristate "'badass' cpufreq policy governor"
	select CPU_FREQ_TABLE
	help
	  'badass' - This driver adds a dynamic cpufreq policy governor.
	  The governor does a periodic polling and
	  changes frequency based on the CPU utilization.
	  The support for this governor depends on CPU capability to
	  do fast frequency switching (i.e, very low latency frequency transitions).
	  To compile this driver as a module, choose M here: the
	  module will be called cpufreq_badass.
	  If in doubt, say N.

config CPU_FREQ_GOV_BADASS_2_PHASE
	tristate "'2-phase' power-efficiency badass algorithm"
	depends on CPU_FREQ_GOV_BADASS
	help
	  '2-phase' - This driver adds a new algo to save power

config CPU_FREQ_GOV_BADASS_2_PHASE_FREQ
	int "'2-phase' badass frequency"
	default 1190400
	depends on CPU_FREQ_GOV_BADASS
	depends on CPU_FREQ_GOV_BADASS_2_PHASE

config CPU_FREQ_GOV_BADASS_3_PHASE
	tristate "'3-phase' power-efficiency badass algorithm"
	depends on CPU_FREQ_GOV_BADASS
	depends on CPU_FREQ_GOV_BADASS_2_PHASE
	help
	  '3-phase' - This driver adds a new algo to save power

config CPU_FREQ_GOV_BADASS_3_PHASE_FREQ
	int "'3-phase' badass frequency"
	default 1728000
	depends on CPU_FREQ_GOV_BADASS
	depends on CPU_FREQ_GOV_BADASS_2_PHASE
	depends on CPU_FREQ_GOV_BADASS_3_PHASE

config CPU_FREQ_GOV_BADASS_GPU_CONTROL
	tristate "'gpu_control' power-efficiency badass algorithm"
	depends on CPU_FREQ_GOV_BADASS
	depends on CPU_FREQ_GOV_BADASS_2_PHASE
	help
	  'gpu_control' - This driver adds a new algo to save power

config CPU_FREQ_GOV_BADASS_LOWBAT_POWERSAVE
	tristate "'lowbat_powersave' power-efficiency badass algorithm"
	depends on CPU_FREQ_GOV_BADASS
	help
	  'lowbat_powersave' - This driver adds a new algo to save power

config CPU_FREQ_GOV_BADASS_ALLOW_BYPASS
	tristate "Allows bypassing phases"
	depends on CPU_FREQ_GOV_BADASS
	depends on CPU_FREQ_GOV_BADASS_2_PHASE
	help
	  'allow_bypass' - This driver adds a bypass to the phase

config CPU_FREQ_GOV_SMARTASSH3
	tristate "'SmartassH3' cpufreq governor"
	depends on CPU_FREQ
	help
	  SmartassH3 - a "smartassV2 with tweaks by H3ROS" governor!
	  If in doubt, say N.

config CPU_FREQ_GOV_YANKDEMAND
	tristate "'yankdemand' cpufreq policy governor"
	select CPU_FREQ_TABLE
	help
	  'yankdemand' - This driver adds a dynamic cpufreq policy governor.
	  The governor is based on ondemand with just different default settings
	  and can be achieved using ondemand with a script. This is added for
	  simplification purposes for myself.

config CPU_FREQ_GOV_ELEMENTALX
	tristate "'elementalx' cpufreq policy governor"
	select CPU_FREQ_TABLE
	help
	  'elementalx' - This driver adds a dynamic cpufreq policy governor.
	  To compile this driver as a module, choose M here: the
	  module will be called cpufreq_elementalx.
	  For details, take a look at linux/Documentation/cpu-freq.
	  If in doubt, say N.

config CPU_FREQ_GOV_DANCEDANCE
	tristate "'DanceDance' governor"
	help
	  'cpufreq_dancedance' - A dynamic cpufreq governor for
	  Low Latency Frequency Transition capable processors
	  optimised for use in a battery environment
	  Modified code based off conservative with a faster
	  deep sleep rate
	  If in doubt, say N.

config CPU_FREQ_GOV_SAVAGEDZEN
	tristate "'savagedzen' cpufreq governor"
	depends on CPU_FREQ
	help
	   'Savaged-Zen' - a "smartass" based governor
	   If in doubt, say N.

config CPU_FREQ_GOV_HYPER
	tristate "'hyper' cpufreq governor"
	depends on CPU_FREQ
	help
	  'hyper' - a tweaked "ondemand" based smart and smooth optimized governor

config CPU_FREQ_GOV_ADAPTIVE
	tristate "'adaptive' cpufreq policy governor"
	default y
	
config CPU_FREQ_GOV_LAGFREE
        tristate "'lagfree' cpufreq governor"
        depends on CPU_FREQ
        default n
		
config LAGFREE_MAX_LOAD
	int "Max CPU Load"
	default 50
	depends on CPU_FREQ_GOV_LAGFREE
	
config LAGFREE_MIN_LOAD
	int "Min CPU Load"
	default 15
	depends on CPU_FREQ_GOV_LAGFREE
	help
	  CPU freq will be decrease if measured load < min_cpu_load;

config LAGFREE_FREQ_STEP_DOWN
	int "Frequency Step Down"
	default 256000
	depends on CPU_FREQ_GOV_LAGFREE
	help
	  Max freqeuncy delta when ramping down.

config LAGFREE_FREQ_SLEEP_MAX
	int "Max Sleep frequeny"
	default 300000
	depends on CPU_FREQ_GOV_LAGFREE
	help
	  Max freqeuncy for screen off.

config LAGFREE_FREQ_AWAKE_MIN
	int "Min Awake frequeny"
	default 300000
	depends on CPU_FREQ_GOV_LAGFREE
	help
	  Min freqeuncy for screen on.

config LAGFREE_FREQ_STEP_UP_SLEEP_PERCENT
	int "Freq step up percent sleep"
	default 20
	depends on CPU_FREQ_GOV_LAGFREE
	help
	  Frequency percent to step up while screen off.

config CPU_FREQ_GOV_BLU_ACTIVE
	tristate "'blu_active' cpufreq policy governor"
	default y
	depends on CPU_FREQ
	
config CPU_FREQ_GOV_OPTIMAX
	tristate "'optimax' cpufreq policy governor"
	default y
	select CPU_FREQ_TABLE
	
config CPU_FREQ_GOV_BARRY_ALLEN
	tristate "'barry_allen' cpufreq policy governor"
	default y
	
config CPU_FREQ_GOV_MYTHX_PLUG
	tristate "'mythx_plug' cpufreq governor"
	default y
  	depends on CPU_FREQ
	
config CPU_FREQ_GOV_BOOSTACTIVE
	tristate "'boostactive' cpufreq policy governor"
	default n
	
config CPU_FREQ_GOV_KTOONSERVATIVEQ
	tristate "'ktoonservativeq' cpufreq governor"
	default y
	depends on CPU_FREQ
	
config CPU_FREQ_GOV_ABYSSPLUG
	tristate "'abyssplug' cpufreq governor"
	default n
	depends on CPU_FREQ && NO_HZ && HOTPLUG_CPU
	
config CPU_FREQ_GOV_SLP
	tristate "'slp' cpufreq policy governor"
    default n

config CPU_FREQ_GOV_UMBRELLA_CORE
	tristate "'umbrella_core' cpufreq policy governor"
        default n
	help
	  'umbrella_core' - This driver adds a dynamic cpufreq policy governor
	  designed for latency-sensitive workloads.

	  The governor is based on interactive to provide a resident controller
	  which interprets unnecessary battery drain as evil.

config CPU_FREQ_GOV_INTERACTIVEX
        default n
		tristate "'interactivex' cpufreq policy governor"

menu "x86 CPU frequency scaling drivers"
depends on X86
source "drivers/cpufreq/Kconfig.x86"
endmenu

menu "ARM CPU frequency scaling drivers"
depends on ARM
source "drivers/cpufreq/Kconfig.arm"
endmenu

menu "PowerPC CPU frequency scaling drivers"
depends on PPC32 || PPC64
source "drivers/cpufreq/Kconfig.powerpc"
endmenu

endif
endmenu
```
