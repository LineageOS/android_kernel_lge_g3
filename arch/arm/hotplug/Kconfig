## drivers/input/sensor/Kconfig
```kconfig
#
# Input misc drivers configuration
#
menuconfig INPUT_SENSOR
	bool "Sensor devices"
	help
	  Say Y here, and a list of Sensor input drivers will be displayed.
	  Everything that didn't fit into the other categories is here. This option
	  doesn't affect the kernel.

	  If unsure, say Y.

config SENSOR_ATMF04
       bool "ATMF04 support"
       depends on I2C
       help
         Support ATMF04 as an input device.

config LGE_T1_CAP
       bool "Capsensor device"
       help
         Support Capsensor as T1 Model.
```

## drivers/input/touchscreen/g3/Kconfig
```kconfig
#
# Touchscreen driver configuration
#

menuconfig TOUCHSCREEN_SYNAPTICS_G3
        bool "LGE CORE with Synaptics for G3"
        help
          This enables lge core with synaptics driver for g3

config TOUCHSCREEN_SYNAPTICS_I2C_RMI4
	tristate "Synaptics DSX I2C touchscreen"
	depends on I2C
	help
	  Say Y here if you have a Synaptics DSX I2C touchscreen
	  connected to your system.

	  If unsure, say N.

	  To compile this driver as a module, choose M here: the
	  module will be called synaptics_i2c_rmi4.

source "drivers/input/touchscreen/g3/DS5/Kconfig"

source "drivers/input/touchscreen/g3/synaptics_dsx/Kconfig"
```

## drivers/input/touchscreen/g3/synaptics_dsx/Kconfig
```kconfig
#
# Synaptics DSX touchscreen driver configuration
#
menuconfig TOUCHSCREEN_SYNAPTICS_DSX
	bool "Synaptics DSX touchscreen"
	default y
	help
	  Say Y here if you have a Synaptics DSX touchscreen connected
	  to your system.

	  If unsure, say N.

if TOUCHSCREEN_SYNAPTICS_DSX

choice
	default TOUCHSCREEN_SYNAPTICS_DSX_I2C
	prompt "Synaptics DSX touchscreen bus interface"
config TOUCHSCREEN_SYNAPTICS_DSX_I2C
	bool "I2C"
	depends on I2C
endchoice

endif
```
